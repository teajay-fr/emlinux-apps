## apps/Config.in
```kconfig
menu Applications
source "$BR2_EXTERNAL/package/owncloud/Config.in"
source "$BR2_EXTERNAL/package/roundcube/Config.in"
source "$BR2_EXTERNAL/package/fetchmail_wakeup/Config.in"
endmenu
```

## apps/package/fetchmail_wakeup/Config.in
```kconfig
config BR2_PACKAGE_FETCHMAIL_WAKEUP
	bool "Fetchmail wakeup"
    select BR2_PACKAGE_FETCHMAIL
    select BR2_PACKAGE_DOVECOT
	help
	  Fetchmail wakeup extension for dovcecot

	  https://github.com/marschap/fetchmail_wakeup
```

## apps/package/mysqlconfig/Config.in
```kconfig
config BR2_PACKAGE_MYSQLCONFIG
	bool "Mysql Configuration"
	help
	  Add a first boost MySql initialization script

if BR2_PACKAGE_MYSQLCONFIG

config BR2_PACKAGE_MYSQLCONFIG_PASSWORD
    string "MySQL root password"
    default "password"
    help
      Specify the password to use as root password for mysql administration

endif
```

## apps/package/owncloud/Config.in
```kconfig
config BR2_PACKAGE_OWNCLOUD
	bool "owncloud"
    select BR2_PACKAGE_PHP
    select BR2_PACKAGE_PHP_EXT_CTYPE
    select BR2_PACKAGE_PHP_EXT_DOM
    select BR2_PACKAGE_PHP_EXT_ICONV
    select BR2_PACKAGE_PHP_EXT_JSON 
    select BR2_PACKAGE_PHP_EXT_LIBXML2 
    select BR2_PACKAGE_PHP_EXT_SIMPLEXML
    select BR2_PACKAGE_PHP_EXT_ZIP
    select BR2_PACKAGE_PHP_EXT_ZLIB
    select BR2_PACKAGE_PHP_EXT_PDO
    select BR2_PACKAGE_PHP_EXT_FILEINFO
    select BR2_PACKAGE_PHP_EXT_BZIP2
    select BR2_PACKAGE_PHP_EXT_FTP
    select BR2_PACKAGE_PHP_EXT_GMP
    select BR2_PACKAGE_PHP_EXT_CURL
    select BR2_PACKAGE_PHP_EXT_OPENSSL
    select BR2_PACKAGE_PHP_EXT_INTL
    select BR2_PACKAGE_PHP_EXT_EXIF
    select BR2_PACKAGE_PHP_EXT_GD
    select BR2_PACKAGE_LIBJPEG
    select BR2_PACKAGE_LIBPNG
    select BR2_PACKAGE_PCRE
    select BR2_PACKAGE_PCRE_UTF
    select BR2_PACKAGE_MYSQL
    select BR2_PACKAGE_MYSQLCONFIG
	help
	  Owncloud is an opensource NAS server package

	  http://www.owncloud.org

if BR2_PACKAGE_OWNCLOUD

config BR2_PACKAGE_OWNCLOUD_DB_PASSWORD
    string "Owncloud database password"
    default "password"
    help
      Specify the password to use as owncloud database password


endif
```

## apps/package/roundcube/Config.in
```kconfig
config BR2_PACKAGE_ROUNDCUBE
	bool "Roundcube"
    select BR2_PACKAGE_PHP
    select BR2_PACKAGE_PHP_EXT_CTYPE
    select BR2_PACKAGE_PHP_EXT_DOM
    select BR2_PACKAGE_PHP_EXT_ICONV
    select BR2_PACKAGE_PHP_EXT_JSON 
    select BR2_PACKAGE_PHP_EXT_LIBXML2 
    select BR2_PACKAGE_PHP_EXT_SIMPLEXML
    select BR2_PACKAGE_PHP_EXT_ZIP
    select BR2_PACKAGE_PHP_EXT_ZLIB
    select BR2_PACKAGE_PHP_EXT_PDO
    select BR2_PACKAGE_PHP_EXT_FILEINFO
    select BR2_PACKAGE_PHP_EXT_BZIP2
    select BR2_PACKAGE_PHP_EXT_FTP
    select BR2_PACKAGE_PHP_EXT_GMP
    select BR2_PACKAGE_PHP_EXT_CURL
    select BR2_PACKAGE_PHP_EXT_OPENSSL
    select BR2_PACKAGE_PHP_EXT_INTL
    select BR2_PACKAGE_PHP_EXT_EXIF
    select BR2_PACKAGE_PHP_EXT_GD
    select BR2_PACKAGE_LIBJPEG
    select BR2_PACKAGE_MYSQL
    select BR2_PACKAGE_MYSQLCONFIG
	help
	  Roundcube is an opensource email web front end

	  http://www.roundcube.org

if BR2_PACKAGE_ROUNDCUBE

config BR2_PACKAGE_ROUNDCUBE_DB_PASSWORD
    string "Roundcube database password"
    default "password"
    help
      Specify the password to use as roundcube database password


endif
```
